## conf/layer.conf
```bitbake
# We have a conf and classes directory, add to BBPATH
BBPATH .= ":${LAYERDIR}"

# We have recipes-* directories, add to BBFILES
BBFILES += "${LAYERDIR}/recipes-*/*/*.bb \
            ${LAYERDIR}/recipes-*/*/*.bbappend"

BBFILE_COLLECTIONS += "meta-custom-extend"
BBFILE_PATTERN_meta-custom-extend = "^${LAYERDIR}/"
BBFILE_PRIORITY_meta-custom-extend = "6"

LAYERDEPENDS_meta-custom-extend = "core"
LAYERSERIES_COMPAT_meta-custom-extend = "scarthgap"
```
